LIST				P=16F877A
#include			<PIC16F877A.INC>
__config			H'3F31'
SS			EQU		0X0021
S1			EQU		0X0022
S2			EQU		0X0023
GS1			EQU		0X0024
GS2			EQU		0X0025
GS3			EQU		0X0026
DURUM		EQU		0X0027
SONUC		EQU		0X0028
SAYI1		EQU		0X0029
SAYI2		EQU		0X003A
BIRLER		EQU		0X003B
ONLAR		EQU		0X003C

ORG				0X0000
GOTO			AYAR

ORG				0X0009
GOTO			MAIN

AYAR
	CLRF			PORTD
	BSF				STATUS,RP0
	BCF				STATUS,RP1
	MOVLW			0X06
	MOVWF			ADCON1
	CLRF			TRISA
	CLRF			TRISB
	MOVLW			0XF0
	MOVWF			TRISD
	BCF				STATUS,RP0
	BCF				STATUS,RP1
	NOP
	CALL			SILL
	NOP
	GOTO			MAIN

;-------HER ÝHTÝMALE KARÞI REGISTER'LARI SIFIRLAMA-----

SILL
	CLRF			ONLAR
	CLRF			SAYI1
	CLRF			SAYI2
	CLRF			SONUC
	CLRF			DURUM
	BCF				PORTA,0
	BSF				PORTA,1
	MOVLW			0X00
	CALL			SAYILAR
	MOVWF			PORTB
	RETURN

MAIN
;-----ÝLK DÝKEY SIRA ÝÇÝN GEREKLÝ BUTON KONTROLLERÝ(1-2-3-/)-----

		MOVLW			0X01
		MOVWF			PORTD
		BTFSC			PORTD,4
		CALL			BIR
		BTFSC			PORTD,5
		CALL			IKI
		BTFSC			PORTD,6
		CALL			UC
		BTFSC			PORTD,7
		BSF				DURUM,3

;-----2. DÝKEY SIRA ÝÇÝN GEREKLÝ BUTON KONTROLLERÝ(4-5-6-*)-----

		MOVLW			0X02
		MOVWF			PORTD
		BTFSC			PORTD,4
		CALL			DORT
		BTFSC			PORTD,5
		CALL			BES
		BTFSC			PORTD,6
		CALL			ALTI
		BTFSC			PORTD,7
		BSF				DURUM,2

;-----3. DÝKEY SIRA ÝÇÝN GEREKLÝ BUTON KONTROLLERÝ(7-8-9-[-])-----

		MOVLW			0X04
		MOVWF			PORTD
		BTFSC			PORTD,4
		CALL			YEDI
		BTFSC			PORTD,5
		CALL			SEKIZ
		BTFSC			PORTD,6
		CALL			DOKUZ
		BTFSC			PORTD,7
		BSF				DURUM,1

;-----4. DÝKEY SIRA ÝÇÝN GEREKLÝ BUTON KONTROLLERÝ(ONOFF-0-=-+)-----

		MOVLW			0X08
		MOVWF			PORTD
		BTFSC			PORTD,4
		GOTO			ONOFF
		BTFSC			PORTD,5
		CALL			SIFIR
		BTFSC			PORTD,6
		GOTO			ISLEM
		BTFSC			PORTD,7
		BSF				DURUM,0

	GOTO			MAIN

METIN
	BTFSC			DURUM,4
	CALL			S2GOSTER
	BTFSS			DURUM,4
	CALL			S1GOSTER
	RETURN
;---------------9 SAYISININ ÝÞLEMLERÝ-----------------

DOKUZ
	MOVLW			0X09
	CALL			METIN
	BTFSC			PORTD,6
	GOTO			$-1
	RETURN

;---------------8 SAYISININ ÝÞLEMLERÝ-----------------

SEKIZ
	MOVLW			0X08
	CALL			METIN
	BTFSC			PORTD,5
	GOTO			$-1
	RETURN

;---------------7 SAYISININ ÝÞLEMLERÝ-----------------

YEDI
	MOVLW			0X07
	CALL			METIN
	BTFSC			PORTD,4
	GOTO			$-1
	RETURN

;---------------6 SAYISININ ÝÞLEMLERÝ-----------------

ALTI
	MOVLW			0X06
	CALL			METIN
	BTFSC			PORTD,6
	GOTO			$-1
	RETURN

;---------------5 SAYISININ ÝÞLEMLERÝ-----------------

BES
	MOVLW			0X05
	CALL			METIN
	BTFSC			PORTD,5
	GOTO			$-1
	RETURN

;---------------4 SAYISININ ÝÞLEMLERÝ-----------------

DORT
	MOVLW			0X04
	CALL			METIN
	BTFSC			PORTD,4
	GOTO			$-1
	RETURN

;---------------3 SAYISININ ÝÞLEMLERÝ-----------------

UC
	MOVLW			0X03
	CALL			METIN
	BTFSC			PORTD,6
	GOTO			$-1
	RETURN

;---------------2 SAYISININ ÝÞLEMLERÝ-----------------

IKI
	MOVLW			0X02
	CALL			METIN
	BTFSC			PORTD,5
	GOTO			$-1
	RETURN

;---------------1 SAYISININ ÝÞLEMLERÝ-----------------

BIR
	MOVLW			0X01
	CALL			METIN
	BTFSC			PORTD,4
	GOTO			$-1
	RETURN

;---------------0 SAYISININ ÝÞLEMLERÝ-----------------

SIFIR
	MOVLW			0X00
	CALL			METIN
	BTFSC			PORTD,5
	GOTO			$-1
	RETURN

;---------------GÝRÝLEN ÝLK SAYIYI GÖSTER-----------------

S1GOSTER
	MOVWF			SAYI1
	CALL			SAYILAR
	BSF				PORTA,1
	MOVWF			PORTB
	BSF				DURUM,4
	RETURN

;---------------GÝRÝLEN 2. SAYIYI GÖSTER------------------

S2GOSTER
	MOVWF			SAYI2
	CALL			SAYILAR
	BSF				PORTA,1
	MOVWF			PORTB
	RETURN

;---------------PROGRAMI SONLANDIR------------------------

ONOFF
	CALL			SILL
	MOVLW			0X08
	MOVWF			PORTD
	LOOP
		BTFSC			PORTD,4
		GOTO			LOOP
		GOTO			MAIN

;---------------ÝÞLEMÝNÝ SEÇME DURUMU---------------------

ISLEM
	BTFSC			DURUM,0
	CALL			TOPLA
	BTFSC			DURUM,1
	CALL			CIKAR
	BTFSC			DURUM,2
	CALL			CARP
	BTFSC			DURUM,3
	CALL			BOL
	CALL 			GOSTER
;---------ÝÞLEM BÝTTÝKTEN SONRA SAYILARI GÖSTERME---------

TEKRAR

	BCF			PORTA,0
	BSF			PORTA,1
	MOVF		BIRLER,W
	CALL		SAYILAR
	MOVWF		PORTB

	CALL		GECIK

	BCF			PORTA,1
	BSF			PORTA,0
	MOVF		ONLAR,W
	CALL		SAYILAR
	MOVWF		PORTB

	CALL		GECIK

	MOVLW		0X08
	MOVWF		PORTD

	BTFSS		PORTD,4
	GOTO		TEKRAR
	
	BSF			PORTA,1
	BSF			PORTA,0
	MOVLW		0X00
	CALL		SAYILAR
	MOVWF		PORTB	
	GOTO		AYAR

;------------------TOPLAMA_ÝÞLEMÝ--------------------------

TOPLA
	MOVF			SAYI1,W
	ADDWF			SAYI2,W
	MOVWF			SONUC
	RETURN

;------------------ÇIKARMA_ÝÞLEMÝ--------------------------

CIKAR
	MOVF			SAYI2,W
	SUBWF			SAYI1,W
	MOVWF			SONUC
	RETURN

;------------------ÇARPMA_ÝÞLEMÝ---------------------------

CARP
	MOVF			SAYI1,W
DON
		ADDWF			SONUC,F
		DECFSZ			SAYI2
		GOTO			DON
	RETURN

;------------------BÖLME_ÝÞLEMÝ----------------------------

BOL
	MOVF			SAYI2,W
	SUBWF			SAYI1,F
		BTFSS			STATUS,C
		GOTO			DON2
		INCF			SONUC
		GOTO			BOL
DON2
	RETURN

;------------------7SEG-GECÝKME----------------------------

GECIK
	MOVLW			0XF0
	MOVWF			S1
GECIK1
		MOVLW			0X0F
		MOVWF			S2
GECIK2
			DECFSZ			S2,F
			GOTO			GECIK2
			DECFSZ			S1,F
			GOTO			GECIK1
	RETURN

;-----------ÝÞLEM SONRASI SAYI KONTROLÜ---------

GOSTER
	BSF				STATUS,C
	MOVLW			0X0A
	SUBWF			SONUC,W
	BTFSS			STATUS,C
	CALL			TEKBAS
	BTFSC			STATUS,C
	CALL			CIFTBAS
	RETURN

;-------------BASAMAKLARA AYIRMA---------------

TEKBAS
		MOVF			SONUC,W
		MOVWF			BIRLER
		RETURN

CIFTBAS
		MOVLW		0X0A
		SUBWF		SONUC,F
			BTFSS		STATUS,C
			GOTO		DONER
			INCF		ONLAR
			GOTO		CIFTBAS
	DONER
		MOVLW		0X0A
		ADDWF		SONUC,F
		CALL		TEKBAS
	RETURN

;---------------PROTEUS ÝÇÝN TABLO---------------

SAYILAR
	ADDWF			PCL,F
	RETLW			0X40
	RETLW			0X79
	RETLW			0X24
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	RETLW			0X10


;---------------PROGRAMI SONLANDIR---------------

END
